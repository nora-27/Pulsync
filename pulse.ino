////code
#define BLYNK_TEMPLATE_ID "template id " 
#define BLYNK_TEMPLATE_NAME "templete name"
//////
//#include <SPI.h>
#include <Wire.h>
#include <Adafruit_GFX.h>
#include <Adafruit_SSD1306.h>
/////
#include "MAX30100_PulseOximeter.h"
#define REPORTING_PERIOD_MS 1000
/////
#include <DHT.h>//adfruit DHT lib
////
#include <Blynk.h>/// anant
#include <ESP8266WiFi.h>
#include <BlynkSimpleEsp8266.h>
#define BLYNK_PRINT Serial
////
#define SCREEN_WIDTH 128 // OLED display width, in pixels
#define SCREEN_HEIGHT 64 // OLED display height, in pixels
////
uint8_t DHTPIN = 2; // DHT11 sensor pin D4
#define DHTTYPE DHT11 // DHT11 sensor type
DHT dht(DHTPIN, DHTTYPE);
////
#define OLED_RESET -1 // Reset pin # (or -1 if sharing Arduino reset pin)
#define SCREEN_ADDRESS 0x3C ///< See datasheet for Address; 0x3D for 128x32, 0x3C for 128x64
Adafruit_SSD1306 display(SCREEN_WIDTH, SCREEN_HEIGHT, &Wire, OLED_RESET);
//// 
#define NUMFLAKES 10 // Number of snowflakes in the animation example
#define ANALOGIN A0 
////
////
char auth[] = "auth code from blynk"; // You should get Auth Token in the Blynk App.
char ssid[] = "hotspot name or wifi name "; // Your WiFi credentials.
char pass[] = "password";
////
#define LOGO_HEIGHT 16
#define LOGO_WIDTH 16
#define REPORTING_PERIOD_MS 1000
PulseOximeter pox;
float temp, hum ,bpm,SpO2 ;
BlynkTimer timer;
////
uint32_t tsLastReport = 0;
////pulsesync logo 
const unsigned char myBitmap_logo [] PROGMEM = 
{
0x00, 0x00, 0x00, 0x00, 0x00, 0x00, 0x00, 0x00, 0x00, 0x00, 0x00, 0x00, 0x00, 0x00, 0x00, 
0x00, 
0x00, 0x00, 0x00, 0x00, 0x00, 0x00, 0x00, 0x00, 0x00, 0x00, 0x00, 0x00, 0x00, 0x00, 0x00, 
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0x00, 0x00, 0x00, 0x00, 0x00, 0x00, 0x00, 0x00, 0x00, 0x00, 0x00, 0x00, 0x00, 0x00, 0x00, 
0x00
};
///heart for the beat 
const unsigned char myBitmap_logo1 [] PROGMEM = 
{
0x00, 0x00, 0x00, 0x00, 0x01, 0xe0, 0x1a, 0x00, 0x07, 0xb0, 0x36, 0x00, 0x07, 0x78, 0x6f, 
0x00, 
0x06, 0xcc, 0xd9, 0x80, 0x0d, 0xb5, 0xde, 0xc0, 0x1b, 0x3b, 0xb3, 0x60, 0x36, 0x1f, 0x61, 
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0x00, 0x00, 0x00, 0x00
};
///
void onBeatDetected()
{
 Serial.println("Beat!");
 display.drawBitmap( 90, 15,myBitmap_logo1 , 28, 28, 1);
 display.setTextSize(1);
 display.setCursor(0,18);
 display.println("* Pulsesync *");
 display.setCursor(0,25);
 display.println("Please register");
 display.display();
}
////
void setup() 
{
 Serial.begin(9600);
 if(!display.begin(SSD1306_SWITCHCAPVCC, SCREEN_ADDRESS))
 {
 Serial.println(F("SSD1306 allocation failed"));
 for(;;); // Don't proceed, loop forever
 }
 display.display();
 delay(2000); // Pause for 2 seconds
 display.clearDisplay();
 display.setTextSize(2);
 display.setTextColor(1);
 //display.setCursor(15, 0);
 pinMode(16,OUTPUT);
 Blynk.begin(auth, ssid, pass);
 display.drawBitmap( 0, 0,myBitmap_logo, 128, 64,WHITE );
 display.display();
 delay(3000);
 display.clearDisplay();
 display.setCursor(15, 0);
 display.println("PULSESYNC");
 display.drawBitmap( 45, 20,myBitmap_logo1, 30, 26,WHITE);
 display.setCursor(40, 50);
 display.println("ISTE");
 display.display();
 
 delay(5000);
 Serial.print("Initializing pulse oximeter..");
 if (!pox.begin())
 {
 Serial.println("FAILED");
 display.clearDisplay();
 display.setTextSize(1);
 display.setTextColor(1);
 display.setCursor(0, 0);
 display.println("FAILED");
 display.display();
 for(;;);
 } 
 else 
 {
 display.clearDisplay();
 display.setTextSize(1);
 display.setTextColor(1);
 display.setCursor(0, 0);
 display.println("SUCCESS");
 display.display();
 Serial.println("SUCCESS");
 
 }
 pox.setIRLedCurrent(MAX30100_LED_CURR_24MA);
 pox.setOnBeatDetectedCallback(onBeatDetected);
 timer.setInterval(1000L,display_1);
 temp = dht.readTemperature();
 hum = dht.readHumidity();
 Blynk.virtualWrite(V3, temp);
 Blynk.virtualWrite(V4, hum);
 display.clearDisplay();
}
////
void loop() 
{
 Blynk.run();
 timer.run();
 pox.update();
 bpm = pox.getHeartRate();
 if(bpm==0)
 {
 display.println("please place ur finger");
 }
 SpO2 = pox.getSpO2();
 if (millis() - tsLastReport > REPORTING_PERIOD_MS) // 
 {
 Serial.print("Heart BPM:");
 Serial.print(bpm);
 Serial.print("-----");
 Serial.print("Oxygen Percent:");
 Serial.print(SpO2);
 ////
 
 tsLastReport = millis();
 //// 
 Blynk.virtualWrite(V1, bpm);
 Blynk.virtualWrite(V2, SpO2);
}
}
void display_1()
{
 display.clearDisplay();
 display.setTextSize(2);
 display.setTextColor(1);
 display.setCursor(45,0);
 display.println(bpm,1);
 display.setCursor(100,0);
 display.setTextSize(2);
 display.setTextColor(1);
 display.setCursor(0, 0);
 display.println("HR");
 display.setTextSize(1);
 display.setCursor(100, 0);
 display.println("bpm");
 display.setTextSize(2);
 display.setTextColor(1);
 display.setCursor(0, 45);
 display.println("Spo2");
 display.setTextSize(2);
 display.setCursor(110, 45);
 display.println("%");
 display.setTextSize(2);
 display.setTextColor(1);
 display.setCursor(60,45);
 display.println(SpO2,1);
 display.display();
}
